## Documentation/devicetree/bindings/sound/everest,es7210.yaml
```yaml
# SPDX-License-Identifier: (GPL-2.0-only OR BSD-2-Clause)
%YAML 1.2
---
$id: http://devicetree.org/schemas/sound/everest,es7210.yaml#
$schema: http://devicetree.org/meta-schemas/core.yaml#

title: Everest ES7210 4-channel audio ADC

maintainers:
  - AtriOS Team <leftymods@users.noreply.github.com>

description: |
  Everest ES7210 4-channel audio ADC

  Pins on the device (for linking into audio routes):

    Inputs:
      * MIC1: Microphone 1 Analog Input
      * MIC2: Microphone 2 Analog Input
      * MIC3: Microphone 3 Analog Input
      * MIC4: Microphone 4 Analog Input

allOf:
  - $ref: dai-common.yaml#

properties:
  compatible:
    enum:
      - everest,es7210

  reg:
    maxItems: 1

  clocks:
    items:
      - description: clock for master clock (MCLK)

  clock-names:
    items:
      - const: mclk

  port:
    $ref: audio-graph-port.yaml#
    unevaluatedProperties: false

  "#sound-dai-cells":
    const: 0

required:
  - compatible
  - reg
  - "#sound-dai-cells"

unevaluatedProperties: false

examples:
  - |
    i2c {
      #address-cells = <1>;
      #size-cells = <0>;
      es7210: codec@40 {
        compatible = "everest,es7210";
        reg = <0x40>;
        clocks = <&clkc CLKID_MCLK0>;
        clock-names = "mclk";
        #sound-dai-cells = <0>;
      };
    };
```

## Documentation/devicetree/bindings/sound/everest,es8156.yaml
```yaml
# SPDX-License-Identifier: (GPL-2.0-only OR BSD-2-Clause)
%YAML 1.2
---
$id: http://devicetree.org/schemas/sound/everest,es8156.yaml#
$schema: http://devicetree.org/meta-schemas/core.yaml#

title: Everest ES8156 8-channel audio DAC

maintainers:
  - AtriOS Team <leftymods@users.noreply.github.com>

description: |
  Everest ES8156 8-channel audio DAC

  Pins on the device (for linking into audio routes):

    Outputs:
      * AOUT1: Analog Output 1
      * AOUT2: Analog Output 2
      * AOUT3: Analog Output 3
      * AOUT4: Analog Output 4
      * AOUT5: Analog Output 5
      * AOUT6: Analog Output 6
      * AOUT7: Analog Output 7
      * AOUT8: Analog Output 8

allOf:
  - $ref: dai-common.yaml#

properties:
  compatible:
    enum:
      - everest,es8156

  reg:
    maxItems: 1

  clocks:
    items:
      - description: clock for master clock (MCLK)

  clock-names:
    items:
      - const: mclk

  port:
    $ref: audio-graph-port.yaml#
    unevaluatedProperties: false

  "#sound-dai-cells":
    const: 0

required:
  - compatible
  - reg
  - "#sound-dai-cells"

unevaluatedProperties: false

examples:
  - |
    i2c {
      #address-cells = <1>;
      #size-cells = <0>;
      es8156: codec@8 {
        compatible = "everest,es8156";
        reg = <0x08>;
        clocks = <&clkc CLKID_MCLK0>;
        clock-names = "mclk";
        #sound-dai-cells = <0>;
      };
    };
```

## Documentation/devicetree/bindings/sound/silergy,sy6045s.yaml
```yaml
# SPDX-License-Identifier: (GPL-2.0-only OR BSD-2-Clause)
%YAML 1.2
---
$id: http://devicetree.org/schemas/sound/silergy,sy6045s.yaml#
$schema: http://devicetree.org/meta-schemas/core.yaml#

title: Silergy SY6045S Class-D audio amplifier

maintainers:
  - AtriOS Team <leftymods@users.noreply.github.com>

description: |
  Silergy SY6045S digital input Class-D audio amplifier.

properties:
  compatible:
    enum:
      - silergy,sy6045s

  reg:
    maxItems: 1

  "#sound-dai-cells":
    const: 0

  vddio-supply:
    description: Digital I/O supply (typically 3.3V)

  pvdd-supply:
    description: Power supply for output stage (typically 5V or 12V)

  pbtl-mode:
    type: boolean
    description: Enable PBTL (Parallel BTL) mode for bridged mono operation

required:
  - compatible
  - reg
  - vddio-supply
  - pvdd-supply

unevaluatedProperties: false

examples:
  - |
    i2c {
      #address-cells = <1>;
      #size-cells = <0>;

      tweeter_amp: amplifier@2a {
        compatible = "silergy,sy6045s";
        reg = <0x2a>;
        #sound-dai-cells = <0>;
        vddio-supply = <&vcc_3v3>;
        pvdd-supply = <&vcc_5v>;
      };

      woofer_amp: amplifier@2b {
        compatible = "silergy,sy6045s";
        reg = <0x2b>;
        #sound-dai-cells = <0>;
        vddio-supply = <&vcc_3v3>;
        pvdd-supply = <&vcc_5v>;
        pbtl-mode;
      };
    };
```
